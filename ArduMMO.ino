#include <Arduboy2.h>

Arduboy2 ab;
Sprites sprites;



bool moving = false;
bool playerSpriteSwap = false;
byte playerX = 16;
byte playerY = 16;

int xOffset = 0;
int yOffset = 0;


const unsigned char PROGMEM knightSprites[] =
{
// width, height,
16, 16,
// FRAME 00
0x00, 0x00, 0x00, 0x80, 0x00, 0x80, 0x00, 0xfe, 0x7c, 0xfe, 0x6c, 0xfe, 0x0c, 0xfe, 0x0c, 0xfe, 
0xec, 0xfe, 0xfc, 0xfe, 0x00, 0xfe, 0x00, 0x00, 0x00, 0xf0, 0xf0, 0xf8, 0x00, 0xf0, 0x00, 0x00, 
0x00, 0x00, 0x00, 0x1f, 0x1f, 0x3f, 0x3b, 0x7f, 0x21, 0x7f, 0x3b, 0x7f, 0x1f, 0x7f, 0x00, 0x7f, 
0x3c, 0x7f, 0x30, 0x7f, 0x06, 0x7f, 0x18, 0x3f, 0x34, 0x7f, 0x37, 0x7f, 0x14, 0x3f, 0x00, 0x1c, 

// FRAME 01
0x00, 0x00, 0x00, 0x00, 0x00, 0x00, 0x00, 0xfe, 0xfc, 0xfe, 0xec, 0xfe, 0x0c, 0xfe, 0x0c, 0xfe, 
0xec, 0xfe, 0xfc, 0xfe, 0x00, 0xfe, 0x00, 0x80, 0x00, 0xf8, 0xf8, 0xfc, 0x00, 0xf8, 0x00, 0x00, 
0x00, 0x00, 0x00, 0x3f, 0x3e, 0x7f, 0x76, 0xff, 0x42, 0xff, 0x76, 0xff, 0x3e, 0xff, 0x00, 0xff, 
0x3c, 0x7f, 0x30, 0x7f, 0x06, 0x7f, 0x0c, 0x1f, 0x1a, 0x3f, 0x1b, 0x3f, 0x0a, 0x1f, 0x00, 0x1e,
};

const unsigned char PROGMEM tileSheet[] =
{
// width, height,
16, 16,
// TILE 00
0xcf, 0xff, 0xfd, 0xff, 0x3f, 0xff, 0xff, 0xf3, 0xbf, 0xff, 0xff, 0xff, 0xff, 0xf9, 0xff, 0xff, 
0xfb, 0xff, 0xcf, 0xff, 0xff, 0xff, 0x9f, 0xff, 0xff, 0xf3, 0xff, 0xbf, 0xfc, 0xff, 0xff, 0xff, 
// TILE 01
0x3f, 0xbf, 0x21, 0x1d, 0xfd, 0xf1, 0x3f, 0xf1, 0xfd, 0xf1, 0x3d, 0xf1, 0x1d, 0x21, 0xbf, 0x3f, 
0x80, 0xbf, 0xbf, 0x80, 0xbf, 0xbf, 0x87, 0xbb, 0x83, 0xbb, 0x87, 0xbf, 0x80, 0xbf, 0xbf, 0x80, 
};

const byte worldMap[] = {
  //Dimensions
  16,
  //Data,
  0,1,0,0,0,0,0,0,0,0,0,0,0,0,0,0,
  0,1,0,0,0,0,0,0,0,0,0,0,0,0,0,0,
  0,1,0,0,0,0,0,0,0,0,0,0,0,0,0,0,
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  0,1,0,0,0,0,0,0,0,0,0,0,0,0,0,0,
};

void setup() {
  ab.begin();
  Serial.begin(9600);
  ab.setFrameRate(30);

}

void loop() {
  if (!(ab.nextFrame())) return;
  
  ab.pollButtons();
  
  byte dimension = worldMap[0];
  int mapSize = dimension * dimension;

if(playerX >= (dimension*16)-(4*16)) {
    xOffset = (dimension*16)-(8*16);
}
    else if(playerX > 56) {
    xOffset = playerX-56;
  } else {
    xOffset = 0;
  }

  
if(playerY >= (dimension*16)-(4*16)) {
    yOffset = (dimension*16)-(2*16);
}
    else if(playerY > 24) {
    yOffset = playerY-24;
  } else {
    yOffset = 0;
  }

  

  
  yOffset = (playerY > 24 && playerY < (dimension*16)-24) ? playerY-24 : 0;
  
    Serial.print(dimension);
  for(int x = 0; x < mapSize; x++) {
    Serial.print("for");
    byte y = (x/dimension); 
    int newX = (x - (y*dimension)) ;
    sprites.drawOverwrite((newX*16)-xOffset,(y*16)-yOffset, tileSheet, worldMap[x+1]);
  }

  sprites.drawPlusMask(playerX-xOffset,playerY-yOffset,knightSprites, playerSpriteSwap);

  if (ab.pressed(LEFT_BUTTON) && playerX - 1 > 0) {
    playerX -= 2;
    if(ab.everyXFrames(5)) {
      playerSpriteSwap = !playerSpriteSwap;
    }
  } else if (ab.pressed(RIGHT_BUTTON) && playerX + 1 < (dimension*16)-8) {
    playerX += 2;
    if(ab.everyXFrames(5)) {
      playerSpriteSwap = !playerSpriteSwap;
    }
  } else if (ab.pressed(UP_BUTTON) && playerY - 1 > 0) {
    playerY -= 2;
    if(ab.everyXFrames(5)) {
      playerSpriteSwap = !playerSpriteSwap;
    }
  } else if (ab.pressed(DOWN_BUTTON) && playerY + 2 < (dimension*16)-8) {
    playerY += 2;
    if(ab.everyXFrames(5)) {
      playerSpriteSwap = !playerSpriteSwap;
    }
  }


  
  ab.display(true);
  
}
